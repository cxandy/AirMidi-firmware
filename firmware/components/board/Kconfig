## firmware/components/board/Kconfig
```kconfig
menu "airmidi board"

    choice AIRMIDI_BOARD
        prompt "Board"
        default AIRMIDI_BOARD_XIAO_C6 if IDF_TARGET_ESP32C6
        default AIRMIDI_BOARD_XIAO_S3 if IDF_TARGET_ESP32S3
        help
            The receiver PCB (rev A) with the XIAO module it carries. Selects the pin table and the board init.

        config AIRMIDI_BOARD_XIAO_C6
            bool "receiver rev A + XIAO ESP32-C6"
            depends on IDF_TARGET_ESP32C6

        config AIRMIDI_BOARD_XIAO_S3
            bool "receiver rev A + XIAO ESP32-S3"
            depends on IDF_TARGET_ESP32S3

        config AIRMIDI_BOARD_DEVKITC_S3
            bool "ESP32-S3-DevKitC-1 on its own"
            depends on IDF_TARGET_ESP32S3
            help
                A bare dev kit on its native USB port: USB MIDI, the radios and the web UI, no TRS jacks wired
                (UART MIDI on GPIO17/18 if you add them), no battery, the BOOT button as the box's button.

        config AIRMIDI_BOARD_DIRECT_S3
            bool "Bare ESP32-S3 with a TRS port of its own"
            depends on IDF_TARGET_ESP32S3
            help
                A bare ESP32-S3 with its TRS port straight off two pins, 22 ohm in series on each: TIP on GPIO14,
                RING on GPIO15 (held high, so the data is on the TIP: Type A), and the input through a 6N137 on
                GPIO21. Type B (the two pins swapped) is pending.
    endchoice

endmenu
```
